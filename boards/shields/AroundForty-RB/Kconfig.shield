## boards/shields/AroundForty-RB/Kconfig.shield
```kconfig
config SHIELD_AROUNDFORTY_RB_R
    def_bool $(shields_list_contains,AroundForty-RB_R)

config SHIELD_AROUNDFORTY_RB_L
    def_bool $(shields_list_contains,AroundForty-RB_L)
```

## config/west.yml
```yaml
manifest:
  remotes:
    - name: zmkfirmware
      url-base: https://github.com/zmkfirmware
    # PMW3610センサーモジュール
    - name: badjeff
      url-base: https://github.com/badjeff
    # RGB Widgetモジュール
    - name: caksoylar
      url-base: https://github.com/caksoylar
  projects:
    - name: zmk
      remote: zmkfirmware
      revision: v0.3.0
      import: app/west.yml
    - name: zmk-pmw3610-driver
      remote: badjeff
      revision: zmk-0.3
    - name: zmk-rgbled-widget
      remote: caksoylar
      revision: main
  self:
    path: config
```
