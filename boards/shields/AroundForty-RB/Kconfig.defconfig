## boards/shields/AroundForty-RB/Kconfig.defconfig
```kconfig
if SHIELD_AROUNDFORTY_RB_L || SHIELD_AROUNDFORTY_RB_R
    config ZMK_KEYBOARD_NAME
        default "AroundFortyRB"

    config NFCT_PINS_AS_GPIOS
        default y

    config ZMK_SPLIT
        default y

    config ZMK_POINTING
        default y
endif
```
